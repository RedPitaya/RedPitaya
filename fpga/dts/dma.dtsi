/*
 * Disable DMA after boot, must be anabled by a DT overlay
 * TODO: it is probably not necessary to also disable each channel
 */

&axi_dma_0 {
	status = "disabled";
};

/*
 * Add Red Pitaya custom DMA consumer
 */

&amba_pl {
	rprx_0: rprx@0 {
		compatible ="redpitaya,rprx";
		dmas = <&axi_dma_0 0
		        &axi_dma_0 1>;
		dma-names = "axidma0", "axidma1";
		memory-region = <&rprx_reserverd>;
		status = "disabled";
	};
};
