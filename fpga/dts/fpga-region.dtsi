/*
 * FPGA region
*/

// use FPGA manager driver instead of the Xilinx devcfg driver
&devcfg {
	compatible = "xlnx,zynq-pcap-fpga";
};

&amba {
	fpga_region0: fpga-region0 {
		compatible = "fpga-region";
		fpga-mgr = <&devcfg>;
		#address-cells = <0x1>;
		#size-cells = <0x1>;
		ranges;
	};
};
