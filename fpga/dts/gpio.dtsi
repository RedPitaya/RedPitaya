/*
 * GPIO names
 */

&gpio0 {
	gpio-line-names =
                "MIO0 (TP19)",
                "MIO1 (TP20)",
                "MIO2 (ENAPWRIN)",
                "MIO3 (ENAPWROUT)",
                "MIO4 (MIO4)",
                "MIO5 (MIO5)",
                "MIO6 (LED 8)",
		"MIO7 (LED 9)",
		"MIO8 (UART1_TX)",
		"MIO9 (UART1_RX)",
		"MIO10 (SPI1_MOSI)",
		"MIO11 (SPI1_MISO)",
		"MIO12 (SPI1_CLK)",
		"MIO13 (SPI1_CS#)",
		"MIO14 (UART0_RX)",
		"MIO15 (UART0_TX)",
		"MIO16 (ETH_TXCLK)",
		"MIO17 (ETH_TXD0)",
		"MIO18 (ETH_TXD1)",
		"MIO19 (ETH_TXD2)",
		"MIO20 (ETH_TXD3)",
		"MIO21 (ETH_TXCTL)",
		"MIO22 (ETH_RXCLK)",
		"MIO23 (ETH_RXD0)",
		"MIO24 (ETH_RXD1)",
		"MIO25 (ETH_RXD2)",
		"MIO26 (ETH_RXD3)",
		"MIO27 (ETH_RXCTL)",
		"MIO28 (USB_D4)",
		"MIO29 (USB_DIR)",
		"MIO30 (USB_STP)",
		"MIO31 (USB_NXT)",
		"MIO32 (USB_D0)",
		"MIO33 (USB_D1)",
		"MIO34 (USB_D2)",
		"MIO35 (USB_D3)",
		"MIO36 (USB_CLK)",
		"MIO37 (USB_D5)",
		"MIO38 (USB_D6)",
		"MIO39 (USB_D7)",
		"MIO40 (SDIO_CLK)",
		"MIO41 (SDIO_CMD)",
		"MIO42 (SDIO_DAT0)",
		"MIO43 (SDIO_DAT1)",
		"MIO44 (SDIO_DAT2)",
		"MIO45 (SDIO_DAT3)",
		"MIO46 (SDIO_SDDET)",
		"MIO47 (SDIO_WP)",
		"MIO48 (USB_RESB)",
                "MIO49 (TP21)",
		"MIO50 (I2C0_SDA)",
		"MIO51 (I2C0_SCL)",
		"MIO52 (ETH_MDC)",
		"MIO53 (ETH_MDIO)",
		"EMIO0 (LED 0)",
		"EMIO1 (LED 1)",
		"EMIO2 (LED 2)",
		"EMIO3 (LED 3)",
		"EMIO4 (LED 4)",
		"EMIO5 (LED 5)",
		"EMIO6 (LED 6)",
		"EMIO7 (LED 7)",
		"EMIO8  (GPIO 0)",
		"EMIO9  (GPIO 1)",
		"EMIO10 (GPIO 2)",
		"EMIO11 (GPIO 3)",
		"EMIO12 (GPIO 4)",
		"EMIO13 (GPIO 5)",
		"EMIO14 (GPIO 6)",
		"EMIO15 (GPIO 7)",
		"EMIO16 (GPIO 8)",
		"EMIO17 (GPIO 9)",
		"EMIO18 (GPIO 10)",
		"EMIO19 (GPIO 11)",
		"EMIO20 (GPIO 12)",
		"EMIO21 (GPIO 13)",
		"EMIO22 (GPIO 14)",
		"EMIO23 (GPIO 15)",
		"EMIO24 (GPIO 16)";
};
