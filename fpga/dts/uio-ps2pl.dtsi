/*
 * Add UIO peripherals
 * NOTE: although multiple IRQ are listed here only one will work
 */

&amba_pl {
	ps2pl: ps2pl@40000000 {
		compatible = "generic-uio";
		reg = <0x40000000 0x40000000>,
		      <0x80000000 0x40000000>;
		reg-names = "m_axi_gp0", "m_axi_gp1";
		interrupts = <0 68 4>, <0 67 4>, <0 66 4>, <0 65 4>, <0 64 4>, <0 63 4>, <0 62 4>, <0 61 4>,
		             <0 91 4>, <0 90 4>, <0 89 4>, <0 88 4>, <0 87 4>, <0 86 4>, <0 85 4>, <0 84 4>;
		interrupt-names = "irqf2p7", "irqf2p6", "irqf2p5", "irqf2p4", "irqf2p3", "irqf2p2", "irqf2p1", "irqf2p0",
		                  "irqf2p15", "irqf2p14", "irqf2p13", "irqf2p12", "irqf2p11", "irqf2p10", "irqf2p9", "irqf2p8";
		interrupt-parent = <&intc>;
	};
};
