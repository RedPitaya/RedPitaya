/*
 * USB PHY configuration
*/

/ {
	usb_phy0: phy0 {
		compatible = "ulpi-phy";
		#phy-cells = <0>;
		reg = <0xe0002000 0x1000>;
		view-port = <0x0170>;
		drv-vbus;
	};
};
&usb0 {
	usb-phy = <&usb_phy0>;
};
