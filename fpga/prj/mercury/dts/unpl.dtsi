/*
 * Disable DMA after boot, must be anabled by a DT overlay
 * TODO: it is probably not necessary to also disable each channel
 */

/delete-node/ &axi_intc_0;

&axi_dma_la {
	status = "disabled";
};
&axi_dma_osc0 {
	status = "disabled";
};
&axi_dma_osc1 {
	status = "disabled";
};
