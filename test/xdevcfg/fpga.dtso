/dts-v1/;
/plugin/;
/ {
	fragment@0 {
		target = <&fpga_region0>;
		#address-cells = <1>;
		#size-cells = <1>;
		__overlay__ {
			#address-cells = <1>;
			#size-cells = <1>;
			firmware-name = "redpitaya/axi4lite.bin";
		};
	};
};
