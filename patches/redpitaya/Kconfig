## patches/redpitaya/Kconfig
```kconfig
config RPRX
	tristate "Red Pitaya receiver DMA client for XILINX AXI DMA provider driver"
	depends on XILINX_AXIDMA
	help
	  Simple DMA receiver client driver. Y fo Red Pitaya
```

## patches/u-boot/zynq_red_pitaya_defconfig
```kconfig
CONFIG_ARM=y
CONFIG_ARCH_ZYNQ=y
CONFIG_TARGET_ZYNQ_RED_PITAYA=y
CONFIG_DEFAULT_DEVICE_TREE="zynq-red-pitaya"
CONFIG_SPL=y
CONFIG_SYS_PROMPT="Zynq> "
#CONFIG_FIT=y
#CONFIG_FIT_VERBOSE=y
# CONFIG_FIT_SIGNATURE is not set
# CONFIG_CMD_IMLS is not set
# CONFIG_CMD_FLASH is not set
CONFIG_CMD_GPIO=y
# CONFIG_CMD_SETEXPR is not set
CONFIG_OF_EMBED=y
# CONFIG_OF_CONTROL is not set
CONFIG_SPL_DM_SEQ_ALIAS=y
CONFIG_ZYNQ_GEM=y
```

## patches/zynq_red_pitaya_defconfig
```kconfig
CONFIG_SPL=y
+S:CONFIG_ARM=y
+S:CONFIG_ZYNQ=y
+S:CONFIG_TARGET_ZYNQ_RED_PITAYA=y
CONFIG_OF_CONTROL=n
CONFIG_DEFAULT_DEVICE_TREE="zynq-red-pitaya"
```
