/*
 * Remove the existing 'devcfg' node and replace it with a 'fpga_bus' node
 */

/delete-node/ &devcfg;

&amba { 
	fpga_bus@f8007000 {
		compatible = "altr,fpga-bus", "simple-bus";
		#address-cells = <1>;
		#size-cells = <1>;
		ranges;
		fpga_mgr0: devcfg@f8007000 {
			compatible = "xlnx,zynq-devcfg-1.0","simple-bus";
			reg = <0xf8007000 0x100>;
			interrupt-parent = <&intc>;
			interrupts = <0 8 4>;
			clocks = <&clkc 12>, <&clkc 15>, <&clkc 16>, <&clkc 17>, <&clkc 18>;
			clock-names = "ref_clk", "fclk0", "fclk1", "fclk2", "fclk3";
			syscon = <&slcr>;
			#address-cells = <1>;
			#size-cells = <1>;
			ranges;
		};
	};
};
